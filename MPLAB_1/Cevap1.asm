	LIST P=16F628A
    INCLUDE "P16F628A.INC"
    __CONFIG _BODEN_OFF & _CP_OFF & _DATA_CP_OFF & _PWRTE_OFF & _WDT_OFF & _LVP_OFF & _MCLRE_OFF & _XT_OSC


SAYAC1 EQU h'20'
SAYAC2 EQU h'21'
SAYAC3 EQU h'22'
    ORG h'00'
AYARLAMALAR
    CLRF PORTA ; 
    BANKSEL TRISA
    MOVLW b'11101111' ; 
    MOVWF TRISA ;
    BANKSEL PORTA
    BCF PORTA,4 
BASLA
    BTFSC PORTA,0         
    GOTO BASLA            
    GOTO RA5_BAS        
RA5_BAS
    BTFSC PORTA,5        
    GOTO RA5_BAS       
    MOVLW b'11111111'    
    MOVWF PORTA            
    CALL GECIKME        
    MOVLW b'11101111'
    MOVWF PORTA           
    CALL GECIKME
    GOTO BASLA
    BSF PORTA,4 
GECIKME
    MOVLW d'5'
    MOVWF SAYAC1
DONGU1
    MOVLW d'255'
    MOVWF SAYAC2
DONGU2
    MOVLW d'255'
    MOVWF SAYAC3
DONGU3
    DECFSZ SAYAC3,F 
    GOTO DONGU3
    DECFSZ SAYAC2,F
    GOTO DONGU2
    DECFSZ SAYAC1,F
    GOTO DONGU1
    RETURN
    END
